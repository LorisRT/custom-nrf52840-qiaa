## CMakeLists.txt
```
cmake_minimum_required(VERSION 3.20.0)
find_package(Zephyr REQUIRED HINTS $ENV{ZEPHYR_BASE})

project(main)

target_sources(app PRIVATE src/main.c)
```

## prj.conf
```kconfig
# ----------------------------------- #
# Enables floating point manipulation #
# ----------------------------------- #
CONFIG_FPU=y

# -------------------------------------------------- #
# USB: Minimal default configuration for USB CBC ACM #
# -------------------------------------------------- #
CONFIG_USB_DEVICE_STACK=y

# SERIAL turns on the subsystem that provides:
# - UART device model (struct + init),
# - UART API,
# - UART backends.
# Without SERIAL, zephyr can't register the CDC ACM interface as a UART device.
# The data to be passed over physical USB data lines will be passed, in the main application, by uart function calls.
CONFIG_SERIAL=y

CONFIG_USB_CDC_ACM=y

# UART INTERRUPT DRIVEN not really necessary for bare minimum USB CDC ACM but usefull for ISR-based function write and read for uart (e.g. echoed back application). 
CONFIG_UART_INTERRUPT_DRIVEN=y 

# Zephyr does not initialize + enable USB device stack during system init if USB_DEVICE_INITIALIZE_AT_BOOT is set.
# if USB_DEVICE_INITIALIZE_AT_BOOT not set, usb_enable(NULL) is required in main application before using data transfert.
CONFIG_USB_DEVICE_INITIALIZE_AT_BOOT=n

# Use by CDC ACM class to do control-line semantics (DTR/RTS), e.g.: DTR=1, COM port open on Host computer receiving data over USB
CONFIG_UART_LINE_CTRL=y

CONFIG_FLASH_LOAD_OFFSET=0x1000
```

## Custom_Dongle_nrf52840.overlay
```dts
/{

};

&usbd {
    cdc_acm_uart0: cdc_acm_uart0 {
        compatible = "zephyr,cdc-acm-uart";
        label = "CDC_ACM_0";
    };
    status = "okay";
};
```

## src/main.c
```c
// default include provided during app creation
#include <zephyr/kernel.h>

#include <stdbool.h>

#include <zephyr/device.h>

#include <zephyr/drivers/uart.h>
#include <zephyr/usb/usb_device.h>

#define CDC_NODE DT_NODELABEL(cdc_acm_uart0)

const struct device *cdc = DEVICE_DT_GET(CDC_NODE);
const char m[] = "Hello from USB Dongle";

// default main application thread
int main(void)
{
        if (usb_enable(NULL) != 0)
        {
                return 0;
        }

        while(true)
        {
                for(size_t i = 0; i < sizeof(m); i++)
                {
                        uart_poll_out(cdc, m[i]);
                }
                k_sleep(K_SECONDS(3));
        }

        // should not get here
        return 0;
}
```
